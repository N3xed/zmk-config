## Kconfig
```kconfig
config NICE_VIEW_CAPS_STATUS
    bool "Show a CAPS status widget in addition to the normal right-side nice_view widgets"
```

## boards/shields/aurora-corne-uart/Kconfig.defconfig
```kconfig
if SHIELD_AURORA_CORNE_UART_LEFT || SHIELD_AURORA_CORNE_UART_RIGHT

config ZMK_SPLIT
    default y

config ZMK_SPLIT_WIRED
    default y

config ZMK_SPLIT_ROLE_CENTRAL
    default y if SHIELD_AURORA_CORNE_UART_LEFT
endif
```

## boards/shields/aurora-corne-uart/Kconfig.shield
```kconfig
# Copyright (c) 2025 The ZMK Contributors
# SPDX-License-Identifier: MIT

config SHIELD_AURORA_CORNE_UART_LEFT
    def_bool $(shields_list_contains,aurora_corne_uart_left)

config SHIELD_AURORA_CORNE_UART_RIGHT
    def_bool $(shields_list_contains,aurora_corne_uart_right)
```

## boards/shields/nice_view_caps_status/Kconfig.shield
```kconfig
config SHIELD_NICE_VIEW_CAPS_STATUS
    def_bool $(shields_list_contains,nice_view_caps_status)
```

## config/aurora_corne_uart/west.yml
```yaml
manifest:
  remotes:
    - name: zmkfirmware
      url-base: https://github.com/zmkfirmware
  projects:
    - name: zmk
      remote: zmkfirmware
      revision: main
      import: app/west.yml
  self:
    path: config_aurora_corne_uart
```
