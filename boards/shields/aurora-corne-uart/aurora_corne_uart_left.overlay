/*
 * Copyright (c) 2025 The ZMK Contributors
 *
 * SPDX-License-Identifier: MIT
 */

#include "aurora_corne_uart.dtsi"

&kscan0 {
    row-gpios
        = <&gpio0 6 (GPIO_ACTIVE_HIGH | GPIO_PULL_DOWN)>  // Row 0 (D7)
        , <&gpio0 7 (GPIO_ACTIVE_HIGH | GPIO_PULL_DOWN)>  // Row 1 (E6)
        , <&gpio0 8 (GPIO_ACTIVE_HIGH | GPIO_PULL_DOWN)>  // Row 2 (B4)
        , <&gpio0 9 (GPIO_ACTIVE_HIGH | GPIO_PULL_DOWN)>  // Row 3 (B5)
        ;

    col-gpios
        = <&gpio0 23 GPIO_ACTIVE_HIGH>   // Col 0 (B2)
        , <&gpio0 21 GPIO_ACTIVE_HIGH>   // Col 1 (B6)
        , <&gpio0 20 GPIO_ACTIVE_HIGH>   // Col 2 (B3)
        , <&gpio0 22 GPIO_ACTIVE_HIGH>   // Col 3 (B1)
        , <&gpio0 26 GPIO_ACTIVE_HIGH>   // Col 4 (F7)
        , <&gpio0 27 GPIO_ACTIVE_HIGH>   // Col 5 (F6)
        ;
};